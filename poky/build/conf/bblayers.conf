## poky/build/conf/bblayers.conf
```bitbake
# POKY_BBLAYERS_CONF_VERSION is increased each time build/conf/bblayers.conf
# changes incompatibly
POKY_BBLAYERS_CONF_VERSION = "2"

BBPATH = "${TOPDIR}"
BBFILES ?= ""

BBLAYERS ?= " \
  /home/ambu/yocto_tutorial/poky/meta \
  /home/ambu/yocto_tutorial/poky/meta-poky \
  /home/ambu/yocto_tutorial/poky/meta-yocto-bsp \
  /home/ambu/yocto_tutorial/poky/meta-ssd1306 \
  /home/ambu/yocto_tutorial/poky/meta-helloworld \
  "
```

## poky/meta-exptest/conf/layer.conf
```bitbake
# We have a conf and classes directory, add to BBPATH
BBPATH .= ":${LAYERDIR}"

# We have recipes-* directories, add to BBFILES
BBFILES += "${LAYERDIR}/recipes-*/*/*.bb \
            ${LAYERDIR}/recipes-*/*/*.bbappend"

BBFILE_COLLECTIONS += "meta-exptest"
BBFILE_PATTERN_meta-exptest = "^${LAYERDIR}/"
BBFILE_PRIORITY_meta-exptest = "6"

LAYERDEPENDS_meta-exptest = "core"
LAYERSERIES_COMPAT_meta-exptest = "kirkstone"
```

## poky/meta-ina219/conf/layer.conf
```bitbake
# We have a conf and classes directory, add to BBPATH
BBPATH .= ":${LAYERDIR}"

# We have recipes-* directories, add to BBFILES
BBFILES += "${LAYERDIR}/recipes-*/*/*.bb \
            ${LAYERDIR}/recipes-*/*/*.bbappend"

BBFILE_COLLECTIONS += "meta-ina219"
BBFILE_PATTERN_meta-ina219 = "^${LAYERDIR}/"
BBFILE_PRIORITY_meta-ina219 = "6"

LAYERDEPENDS_meta-ina219 = "core"
LAYERSERIES_COMPAT_meta-ina219 = "kirkstone"
```
